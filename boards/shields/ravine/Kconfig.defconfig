## boards/shields/ravine/Kconfig.defconfig
```kconfig
if SHIELD_RAVINE_LEFT

# Name must be less than 16 characters long!
config ZMK_KEYBOARD_NAME
    default "Ravine"
config USB_DEVICE_MANUFACTURER
    default "Zakwaykway"

config ZMK_SPLIT_ROLE_CENTRAL
    default y

endif

if SHIELD_RAVINE_LEFT || SHIELD_RAVINE_RIGHT

config ZMK_SPLIT
    default y

endif
```

## boards/shields/ravine/Kconfig.shield
```kconfig
config SHIELD_RAVINE_LEFT
    def_bool $(shields_list_contains,ravine_left)
  
config SHIELD_RAVINE_RIGHT
    def_bool $(shields_list_contains,ravine_right)
  
```
